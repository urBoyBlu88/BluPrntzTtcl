#include <Arduino.h>

#include <U8g2lib.h>

#ifdef U8X8_HAVE_HW_SPI

  #include <SPI.h>

#endif

#ifdef U8X8_HAVE_HW_I2C

  #include<Wire.h>

#endif
//#include<WiFi.h> //want wifi?

#define SDA_PIN 5

#define SCL_PIN 6

//U8G2_SSD1306_72X40_ER_F_HW_I2C u8g2(U8G2_R0,/* reset=*/U8X8_PIN_NONE);// use for ESP32 S3
//U8G2_SSD1306_128X64_NONAME_F_HW_I2C u8g2(U8G2_R0, /* reset=*/ U8X8_PIN_NONE); // initialization for the 128x64px display for 0.96 oled connected


U8G2_SH1106_72X40_WISE_F_HW_I2C u8g2(U8G2_R0, /* reset=*/ U8X8_PIN_NONE); // esp32 c3

static const unsigned char image_images_1_bits[] U8X8_PROGMEM = {0x00,0x00,0x00,0x00,0x00,0x00,0x00,0x00,0x00,0x00,0x00,0x00,0x00,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0x00,0x00};
// SCL (serial clock) > A5 or SCL
// SDA (serial data) > A4 or SDA


static const unsigned char image_crosshairs_bits[] U8X8_PROGMEM = {0x00,0x00,0x00,0x00,0x20,0x00,0x20,0x00,0x70,0x00,0xa8,0x00,0x24,0x01,0xdf,0x07,
0x24,0x01,0xa8,0x00,0x70,0x00,0x20,0x00,0x20,0x00,0x00,0x00,0x00,0x00,0x00,0x00};

static const unsigned char image_cross_contour_bits[] U8X8_PROGMEM = {0x00,0x00,0x00,0x00,0x00,0x00,0x04,0x01,0x8a,0x02,0x51,0x04,0x22,0x02,0x04,0x01,0x88,0x00,0x04,0x01,0x22,0x02,0x51,0x04,0x8a,0x02,0x04,0x01,0x00,0x00,0x00,0x00};
// IIC connection of the OLED display and Arduino UNO
// +5V > +5V
// GND > GND
// SCL (serial clock) > A5 or SCL
// SDA (serial data) > A4 or SDA

int flashLight = 7;
//int redPin= 3;
int buttonPin = 4;
int curClick = 1;
bool lightState = LOW;

#include <BLEDevice.h>
#include <BLEUtils.h>
#include <BLEServer.h>
#include <BLE2902.h>
String message="blueballs";
char buf[30];
    
// See the following for generating UUIDs:
// https://www.uuidgenerator.net/

#define SERVICE_UUID        "4fafc201-1fb5-459e-8fcc-c5c9c331914b"
#define CHARACTERISTIC_UUID "beb5483e-36e1-4688-b7f5-ea07361b26a8"


class MyCallbacks: public BLECharacteristicCallbacks {
  String value = "";
    void onWrite(BLECharacteristic *pCharacteristic) {
      value = pCharacteristic->getValue();
      for(int i = 0; i < value.length();i++){
        
        buf[i] = (char)value[i];
        
      }
      
    
    }

};




// display a string on multiple text lines, keeping words intact where possible,
// and accepting \n to force a new line
void printwords(const char *msg, int xloc, int yloc /*bottom*/ ) {
   int dspwidth = u8g2.getDisplayWidth(); // display width in pixels
   int strwidth = 0;  // string width in pixels
   char glyph[2]; glyph[1] = 0;
   for (const char *ptr = msg, *lastblank = NULL; *ptr; ++ptr) {
      while (xloc == 0 && (*msg == ' ' || *msg == '\n'))
         if (ptr == msg++) ++ptr; // skip blanks and newlines at the left edge
      glyph[0] = *ptr;
      strwidth += u8g2.getStrWidth(glyph); // accumulate the pixel width
      if (*ptr == ' ')  lastblank = ptr; // remember where the last blank was
      else ++strwidth; // non-blanks will be separated by one additional pixel
      if (*ptr == '\n' ||   // if we found a newline character,
            xloc + strwidth > dspwidth) { // or if we ran past the right edge of the display
         int starting_xloc = xloc;
         // print to just before the last blank, or to just before where we got to
         while (msg < (lastblank ? lastblank : ptr)) {
            glyph[0] = *msg++;
            xloc += u8g2.drawStr(xloc, yloc, glyph); }
         strwidth -= xloc - starting_xloc; // account for what we printed
         yloc += u8g2.getMaxCharHeight(); // advance to the next line
         xloc = 0; lastblank = NULL; } }
   while (*msg) { // print any characters left over
      glyph[0] = *msg++;
      xloc += u8g2.drawStr(xloc, yloc, glyph); 
    } 
      
      
  }


void setup() {

  Serial.begin(9600);
  Wire.begin(SDA_PIN, SCL_PIN);
  //WiFi.softAP("ESP32_AP_TEST"); //only uncomment if you want to use wifi
  u8g2.begin();
  
  pinMode(flashLight,OUTPUT);
    //pinMode(redPin,OUTPUT);
      pinMode(buttonPin,INPUT_PULLUP);
    u8g2.setContrast(255);
   //Serial.println(buttonPin);
  // Serial.println("2- Scan for BLE devices in the app");
  // Serial.println("3- Connect to MyESP32");
  // Serial.println("4- Go to CUSTOM CHARACTERISTIC in CUSTOM SERVICE and write something");
  // Serial.println("5- See the magic =)");

  BLEDevice::init("UglyOptic");
  BLEServer *pServer = BLEDevice::createServer();

  BLEService *pService = pServer->createService(SERVICE_UUID);

  BLECharacteristic *pCharacteristic = pService->createCharacteristic(
                                         CHARACTERISTIC_UUID,
                                         BLECharacteristic::PROPERTY_READ |
                                         BLECharacteristic::PROPERTY_WRITE 
                                       );
  pCharacteristic->setValue("where is it");
   pCharacteristic->addDescriptor(new BLE2902());
  pCharacteristic->setCallbacks(new MyCallbacks());
 
      
    
  
  pService->start();

  BLEAdvertising *pAdvertising = pServer->getAdvertising();
  pAdvertising->start();
  digitalWrite(flashLight, LOW);
//  digitalWrite(buttonPin, LOW);
}
int reticlePosX = 13;
int reticlePosY = -2;
int reticleScaleX = 57;
int reticleScaleY = 40;
void loop() {

  u8g2.firstPage(); // select the first page of the display (page is 128x8px), since we are using the page drawing method of the u8g2 library
  do {
  // put your main code here, to run repeatedly:
   u8g2.clearBuffer();// clear the internal memory
     int buttonState = digitalRead(buttonPin);
    Serial.println(buttonState);
    
    u8g2.setFont(u8g2_font_ncenB08_tr);// choose a suitable font
  //  char bufB[30];
  //     sprintf (bufB, "%02d", buttonState);      
  //     u8g2.drawStr(1,5, bufB);
   
      if(curClick == 1){
           SquareReticle();
      }else if(curClick == 2){
        Acog();
      }else if(curClick == 3){
        Crosshair(); 
      }else if(curClick == 4){
        SquareReticleAndPin();
        
      }else if(curClick == 5){
        
        Xwing();
      }else if(curClick == 6){
        HelloKitty();
      }else if(curClick == 7){
        Elcan();
      }else if(curClick == 8){
        Prigozhin();
      }else if(curClick == 9){
        Goatsie();
      }else if(curClick == 10){
        Eotech();
      }else if(curClick == 11){
        DickButt();
      }else if(curClick == 12){
        PreadtorTraingle();
      }
     
      if (digitalRead(buttonPin) == HIGH)  {
          curClick += 1;
          if (curClick > 12){
              curClick = 1;
          }
          // if(lightState == LOW){
          //   digitalWrite(flashLight, HIGH);
          //   lightState = HIGH;
            
          // }else if(lightState == HIGH){
          //     digitalWrite(flashLight, LOW);
          //     lightState = LOW;
             
          // }
      }
       if(buf[0] == 'f'){
          if(lightState == LOW){
            digitalWrite(flashLight, HIGH);
            lightState = HIGH;
            buf[0] = ' ';
          }else if(lightState == HIGH){
              digitalWrite(flashLight, LOW);
              lightState = LOW;
              buf[0] = ' ';
          }
      }
       if(buf[0] == 'l'){
        if(reticlePosX >= 7){
          //digitalWrite(flashLight, HIGH);
          reticlePosX -=1;
          buf[0] = ' ';
          u8g2.clearBuffer();
        }
      }
      if(buf[0] == 'r'){
        if(reticlePosX <= 16){
          //digitalWrite(flashLight, HIGH);
          reticlePosX +=1;
          buf[0] = ' ';
          u8g2.clearBuffer();
        }
      }

      if(buf[0] == 'u'){
        if(reticlePosY <= 5){
          //digitalWrite(flashLight, HIGH);
          reticlePosY -=1;
          buf[0] = ' ';
          u8g2.clearBuffer();
        }
      }

      if(buf[0] == 'd'){
        if(reticlePosY >= -3){
          //digitalWrite(flashLight, HIGH);
          reticlePosY +=1;
          buf[0] = ' ';
          u8g2.clearBuffer();
        }
      }
      delay(100);
   }while ( u8g2.nextPage() ); // go over all the pages until the whole display is updated
  
 
}



void Acog(){
  u8g2.setFontMode(1);
u8g2.setBitmapMode(1);
u8g2.setDrawColor(2);
u8g2.setFont(u8g2_font_4x6_tr);

u8g2.setDrawColor(1);
u8g2.drawLine(40, 13, 30, 13);
u8g2.drawLine(35, 39, 35, 3);
u8g2.drawLine(45, 10, 35, 0);
u8g2.drawLine(25, 10, 35, 0);
u8g2.drawLine(32, 22, 38, 22);
u8g2.drawLine(30, 30, 40, 30);
// u8g2.drawEllipse(34, 20, 18, 18);
// u8g2.drawXBMP(14, -2, 40, 40, image_images_1_bits);
// u8g2.drawStr(41, 27, "4");
// u8g2.drawLine(36, 26, 31, 26);
// u8g2.drawLine(33, 30, 35, 30);
// u8g2.drawLine(31, 34, 37, 34);
u8g2.sendBuffer();
}


static const unsigned char image_afterBurner_1_bits[] U8X8_PROGMEM = {0x00,0x00,0x00,0x00,0x00,0x00,0x00,0x00,0x00,0x00,0x00,0x00,0x00,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0x00,0x00};

void SquareReticleAndPin(){
  
 
      u8g2.setFontMode(1);
      u8g2.setBitmapMode(1);
      u8g2.drawXBMP(reticlePosX, reticlePosY+4, 45, 32, image_afterBurner_1_bits);
      u8g2.drawXBMP(17+reticlePosX, 12+reticlePosY, 11, 16, image_crosshairs_bits);
      u8g2.sendBuffer();
}

void SquareReticle(){
  
u8g2.clearBuffer();
u8g2.setFontMode(1);
u8g2.setBitmapMode(1);
u8g2.drawXBMP(reticlePosX, reticlePosY+4, 45, 32, image_afterBurner_1_bits);
u8g2.sendBuffer();
 



}

void Crosshair(){
  u8g2.setFontMode(1);
      u8g2.setBitmapMode(1);      
      u8g2.drawXBMP(17+reticlePosX, 14+reticlePosY, 11, 16, image_crosshairs_bits);
      u8g2.sendBuffer();
}

void Xwing(){
u8g2.setFontMode(1);
u8g2.setBitmapMode(1);
  u8g2.drawLine(0, 39, 22, 27);
u8g2.drawLine(71, 39, 50, 27);
u8g2.drawXBMP(31, 11, 11, 16, image_cross_contour_bits);
u8g2.drawLine(71, 0, 50, 12);
u8g2.drawLine(0, 0, 22, 12);
 u8g2.sendBuffer();
}

// 'kittyHelo', 72x40px
static const unsigned char image_kittyHelo_bits[] U8X8_PROGMEM = {0x00,0x00,0x00,0x00,0x00,0x80,0x00,0x00,0x00,0x00,0x80,0x01,0x00,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0x00,0x00};

void HelloKitty(){

   u8g2.clearBuffer();
u8g2.setFontMode(1);
u8g2.setBitmapMode(1);
u8g2.drawXBMP(3+reticlePosX, 4+reticlePosY, 37, 40, image_kittyHelo_bits);
u8g2.sendBuffer();
}
// 'elcan', 72x40px
const unsigned char epd_bitmap_elcan [] PROGMEM = {
	0xff, 0xff, 0xff, 0xff, 0xff, 0xff, 0xff, 0xff, 0xff, 0xff, 0xff, 0xff, 0xff, 0xff, 0xff, 0xff, 
	0xff, 0xff, 0xff, 0xff, 0xff, 0xff, 0xff, 0xff, 0xff, 0xff, 0xff, 0xff, 0xff, 0xff, 0xff, 0xff, 
	0xff, 0xff, 0xff, 0xff, 0xff, 0xff, 0xff, 0xff, 0xff, 0xff, 0xff, 0xff, 0xff, 0xff, 0xff, 0xff, 
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	0xff, 0xff, 0xff, 0xff, 0xff, 0xff, 0xff, 0xff
};

void Elcan(){
   u8g2.setFontMode(1);
      u8g2.setBitmapMode(1);
     
      u8g2.drawXBMP(reticlePosX-13, 2+reticlePosY, 72, 40, epd_bitmap_elcan);
      u8g2.sendBuffer();
}
static const unsigned char image__230505_Yevgeny_Prigozhin_al_0751_f1ef79_bits[] U8X8_PROGMEM = {0x00,0x00,0x00,0x00,0x00,0x00,0x00,0x00,0x00,0x00,0x00,0x00,0x00,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0x00,0x00};

static const unsigned char image_images_bits[] U8X8_PROGMEM = {0x00,0x00,0x00,0x00,0x00,0x00,0x00,0x00,0x00,0x00,0x00,0x00,0x00,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0x00,0x00};
void Prigozhin(){
u8g2.clearBuffer();
u8g2.setFontMode(1);
u8g2.setBitmapMode(1);
u8g2.drawXBMP(reticlePosX-13, 2+reticlePosY, 80, 40, image__230505_Yevgeny_Prigozhin_al_0751_f1ef79_bits);
u8g2.sendBuffer();
delay(500);
u8g2.clearBuffer();
u8g2.setFontMode(1);
u8g2.setBitmapMode(1);
u8g2.drawXBMP(3+reticlePosX, 2+reticlePosY, 40, 40, image_images_bits);
u8g2.sendBuffer();
delay(500);
}



//goatsie
static const unsigned char image_goatsepolo_bits[] U8X8_PROGMEM = {0x00,0x00,0x00,0x00,0x00,0x00,0x00,0x00,0x00,0x00,0x00,0x00,0x00,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0x00,0x00};
void Goatsie(){
  u8g2.clearBuffer();
u8g2.setFontMode(1);
u8g2.setBitmapMode(1);
u8g2.drawXBMP(-6, 4+reticlePosY, 86, 40, image_goatsepolo_bits);
u8g2.sendBuffer();
}


//eotech reticl
static const unsigned char image__9e4e367c_9b05_4bba_b76d_e01ff2fe8b7d___CR0_0_300_400_PT0_SX300_V1____bits[] U8X8_PROGMEM = {0x00,0x00,0x00,0x00,0x00,0x00,0x00,0x00,0x00,0x00,0x00,0x00,0x00,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0x00,0x00};
void Eotech(){
u8g2.clearBuffer();
u8g2.setFontMode(1);
u8g2.setBitmapMode(1);
u8g2.drawXBMP(9+reticlePosX,2+reticlePosY, 30, 40, image__9e4e367c_9b05_4bba_b76d_e01ff2fe8b7d___CR0_0_300_400_PT0_SX300_V1____bits);
u8g2.sendBuffer();
}

//dickbutt
static const unsigned char image_J_27yjq8N5hupmKZHHgl9ktVTknVGYmqi1FcPfizeOs_bits[] U8X8_PROGMEM = {0x00,0x00,0x00,0x3c,0x00,0x00,0x00,0x00,0x00,0x00,0x00,0x00,0x43,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0x00,0x00};

void DickButt(){
u8g2.clearBuffer();
u8g2.setFontMode(1);
u8g2.setBitmapMode(1);
u8g2.drawXBMP(reticlePosX-13, 2+reticlePosY, 71, 40, image_J_27yjq8N5hupmKZHHgl9ktVTknVGYmqi1FcPfizeOs_bits);
u8g2.sendBuffer();
}

//train1 
static const unsigned char image_m7jqIvt_bits[] U8X8_PROGMEM = {0x00,0x00,0x00,0x00,0x00,0x00,0x00,0x00,0x00,0x00,0x00,0x00,0x00,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0x00,0x00};
//tri2
static const unsigned char image_frame_03_delay_0_03s_bits[] U8X8_PROGMEM = {0x00,0x00,0x00,0x00,0x00,0x00,0x00,0x00,0x00,0x00,0x00,0x00,0x00,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0x00,0x00};
//tri3
static const unsigned char image_frame_04_delay_0_03s_bits[] U8X8_PROGMEM = {0x00,0x00,0x00,0x00,0x00,0x00,0x00,0x00,0x00,0x00,0x00,0x00,0x00,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0x00,0x00};
//tri4
static const unsigned char image_frame_25_delay_0_03s_bits[] U8X8_PROGMEM = {0x00,0x00,0x00,0x00,0x00,0x00,0x00,0x00,0x00,0x00,0x00,0x00,0x00,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0x00,0x00};

void PreadtorTraingle(){
  u8g2.clearBuffer();
u8g2.setFontMode(1);
u8g2.setBitmapMode(1);
u8g2.drawXBMP(reticlePosX+3, 2+reticlePosY, 40, 40, image_frame_03_delay_0_03s_bits);
u8g2.sendBuffer();
}

